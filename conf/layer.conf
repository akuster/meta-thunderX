## conf/layer.conf
```bitbake
# We have a conf and classes directory, add to BBPATH
BBPATH .= ":${LAYERDIR}"

# We have a recipes-* directories, add to BBFILES
BBFILES += "${LAYERDIR}/recipes-*/*/*.bb \
    ${LAYERDIR}/recipes-*/*/*.bbappend"

BBFILE_COLLECTIONS += "thunderX"
BBFILE_PATTERN_thunderX = "^${LAYERDIR}/"
BBFILE_PRIORITY_thunderX = "6"
```

## conf/machine/cn88xx-evb.conf
```bitbake
#@TYPE: Machine
#@NAME: Cavium ThunderX CN88XX board
#@DESCRIPTION: ThunderX Little Endian Arm64

DEFAULTTUNE = "thunderx"
require conf/machine/include/thunderX.inc
```

## conf/machine/cn88xxbe-evb.conf
```bitbake
#@TYPE: Machine
#@NAME: Cavium Arm64 ThunderX 
#@DESCRIPTION: ThunderX Big Endian

DEFAULTTUNE = "thunderX_be"
require conf/machine/include/thunderX.inc

KERNEL_DEVICETREE ?= "cavium/thunder-88xx.dtb"
```

## conf/machine/include/thunderX.inc
```bitbake
# Cavium Thunderx Soc

SOC_FAMILY = "thunderX"
include conf/machine/include/soc-family.inc

require conf/machine/include/tune-thunderx.inc

MACHINE_EXTRA_RRECOMMENDS ?= " kernel-modules"
SERIAL_CONSOLES = "115200;ttyAMA0"

#u-boot
KERNEL_EXTRA_ARGS = 'LOADADDR=0x080080000'

PREFERRED_PROVIDER_virtual/kernel ?= "linux-stable"
PREFERRED_VERSION_linux-stable ?= "4.2%"
KERNEL_IMAGETYPE = "uImage"
IMAGE_FSTYPES = " ext4 cpio.gz tar.gz"

MACHINE_EXTRA_RRECOMMENDS ?= " kernel-modules"
MACHINE_FEATURES_append = "pci ext2 serial usbhost vfat"
```

## conf/machine/include/tune-thunderX.inc
```bitbake
require conf/machine/include/arm/arch-armv8.inc

DEFAULTTUNE ?= "thunderX"
AVAILTUNES += "thunderX thunderX_be"

TUNEVALID[thunderX] = "Enable instructions for Cavium ThunderX"

TUNE_CCARGS .= "${@bb.utils.contains("TUNE_FEATURES", "thunderX", " -mcpu=thunderx ", "",d)}"

ARMPKGARCH_tune-thunderX ?= "thunderX"
ARMPKGARCH_tune-thunderX_be ?= "thunderX_be"

TUNE_FEATURES_tune-thunderX ?= "${TUNE_FEATURES_tune-aarch64} thunderX"
TUNE_FEATURES_tune-thunderX_be ?= "${TUNE_FEATURES_tune-thunderX} bigendian"
BASE_LIB_tune-thunderX = "lib64"
BASE_LIB_tune-thunderX_be = "lib64"

PACKAGE_EXTRA_ARCHS_tune-thunderX = "aarch64 thunderX"
PACKAGE_EXTRA_ARCHS_tune-thunderX_be = "aarch64_be thunderX_be"
```
